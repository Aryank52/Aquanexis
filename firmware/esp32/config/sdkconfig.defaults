## firmware/esp32/config/sdkconfig.defaults
```kconfig
# AquaNexis ESP32 Firmware Configuration
# Generated for ESP32-S3 with WiFi + BLE

# Target Configuration
CONFIG_IDF_TARGET="esp32s3"
CONFIG_IDF_TARGET_ESP32S3=y
CONFIG_ESP32S3_DEFAULT_CPU_FREQ_240=y

# Partition Table
CONFIG_PARTITION_TABLE_CUSTOM=y
CONFIG_PARTITION_TABLE_CUSTOM_FILENAME="partitions.csv"
CONFIG_PARTITION_TABLE_OFFSET=0x8000

# Flash Configuration
CONFIG_ESPTOOLPY_FLASHSIZE_8MB=y
CONFIG_ESPTOOLPY_FLASHMODE_QIO=y
CONFIG_ESPTOOLPY_FLASHFREQ_80M=y

# WiFi Configuration
CONFIG_ESP32_WIFI_SW_COEXIST_ENABLE=y
CONFIG_WIFI_SW_COEXIST_PREFERENCE=0
CONFIG_WIFI_SW_COEXIST_BT_BALANCED=y

# Logging
CONFIG_LOG_DEFAULT_LEVEL_INFO=y
CONFIG_LOG_MAXIMUM_LEVEL_VERBOSE=y
CONFIG_LOG_COLORS=y

# Memory
CONFIG_SPIRAM=y
CONFIG_SPIRAM_OCT=y
CONFIG_SPIRAM_SPEED_80M=y
CONFIG_ESP32S3_SPIRAM_CLK_IO=41

# Task Watchdog
CONFIG_ESP_TASK_WDT=y
CONFIG_ESP_TASK_WDT_TIMEOUT_S=30
CONFIG_ESP_TASK_WDT_PANIC=y

# FreeRTOS
CONFIG_FREERTOS_HZ=1000
CONFIG_FREERTOS_CHECK_STACKOVERFLOW_CANARY=y

# MQTT
CONFIG_MQTT_PROTOCOL_311=y
CONFIG_MQTT_TRANSPORT_SSL=y
CONFIG_MQTT_CUSTOM_OUTBOX=y
CONFIG_MQTT_OUTBOX_SIZE=256

# HTTP Client
CONFIG_ESP_HTTP_CLIENT_ENABLE_HTTPS=y
CONFIG_ESP_HTTP_CLIENT_ENABLE_BASIC_AUTH=y

# JSON
CONFIG_CJSON=y

# SPIFFS
CONFIG_SPIFFS=y
CONFIG_SPIFFS_MAX_PARTITION_SIZE=0x100000

# NVS
CONFIG_NVS_ENCRYPTION=y

# OTA
CONFIG_OTA_ALLOW_HTTPS=y
```
